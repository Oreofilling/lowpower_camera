## main/Kconfig.projbuild
```kconfig
menu "CT application"

    config CT_PROV_BLE
        bool "Start the CT-Prov BLE server in config mode"
        default y
        help
            When enabled, config mode starts the CT-Prov GATT server
            (NimBLE advertising) alongside the softAP. Disable for an
            AP-only bench build: the softAP web console (and the CT-Prov
            softAP HTTP transport) stay available, the BLE stack never
            initializes, and its RAM goes to the camera pipeline.

    config CT_NET_HALOW
        bool "Morse/HaLow network module support"
        default y
        help
            Compiles the Morse (HaLow) SDK and its probe path. WiFi-only SKU
            builds can disable it: --gc-sections then drops the whole SDK
            (~10-15 KB of internal RAM statics) from the image.

endmenu
```
